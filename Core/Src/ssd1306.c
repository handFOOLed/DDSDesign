#include "ssd1306.h"
#include "app_config.h"
#include <string.h>

#define OLED_ADDR 0x78U

static uint8_t oled_buffer[OLED_WIDTH * OLED_HEIGHT / 8U];
static uint8_t cursor_x;
static uint8_t cursor_y;

static const uint8_t font5x7[][5] = {
  {0x00,0x00,0x00,0x00,0x00}, {0x00,0x00,0x5F,0x00,0x00}, {0x00,0x07,0x00,0x07,0x00},
  {0x14,0x7F,0x14,0x7F,0x14}, {0x24,0x2A,0x7F,0x2A,0x12}, {0x23,0x13,0x08,0x64,0x62},
  {0x36,0x49,0x55,0x22,0x50}, {0x00,0x05,0x03,0x00,0x00}, {0x00,0x1C,0x22,0x41,0x00},
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  {0x00,0x41,0x36,0x08,0x00}, {0x08,0x04,0x08,0x10,0x08}
};

static void i2c_delay(void)
{
  for (volatile uint32_t i = 0; i < 28U; ++i)
  {
    __NOP();
  }
}

static void sda(uint8_t high)
{
  HAL_GPIO_WritePin(OLED_SDA_GPIO_Port, OLED_SDA_Pin, high ? GPIO_PIN_SET : GPIO_PIN_RESET);
}

static void scl(uint8_t high)
{
  HAL_GPIO_WritePin(OLED_SCL_GPIO_Port, OLED_SCL_Pin, high ? GPIO_PIN_SET : GPIO_PIN_RESET);
}

static void i2c_start(void)
{
  sda(1); scl(1); i2c_delay(); sda(0); i2c_delay(); scl(0);
}

static void i2c_stop(void)
{
  sda(0); scl(1); i2c_delay(); sda(1); i2c_delay();
}

static void i2c_write(uint8_t data)
{
  for (uint8_t i = 0; i < 8U; ++i)
  {
    sda((data & 0x80U) != 0U);
    i2c_delay();
    scl(1);
    i2c_delay();
    scl(0);
    data <<= 1;
  }
  sda(1);
  i2c_delay();
  scl(1);
  i2c_delay();
  scl(0);
}

static void oled_cmd(uint8_t cmd)
{
  i2c_start();
  i2c_write(OLED_ADDR);
  i2c_write(0x00U);
  i2c_write(cmd);
  i2c_stop();
}

static void oled_data(const uint8_t *data, uint16_t len)
{
  i2c_start();
  i2c_write(OLED_ADDR);
  i2c_write(0x40U);
  while (len--)
  {
    i2c_write(*data++);
  }
  i2c_stop();
}

void OLED_Init(void)
{
  HAL_Delay(50);
  oled_cmd(0xAE); oled_cmd(0x20); oled_cmd(0x00); oled_cmd(0xB0);
  oled_cmd(0xC8); oled_cmd(0x00); oled_cmd(0x10); oled_cmd(0x40);
  oled_cmd(0x81); oled_cmd(0x7F); oled_cmd(0xA1); oled_cmd(0xA6);
  oled_cmd(0xA8); oled_cmd(0x3F); oled_cmd(0xA4); oled_cmd(0xD3);
  oled_cmd(0x00); oled_cmd(0xD5); oled_cmd(0x80); oled_cmd(0xD9);
  oled_cmd(0xF1); oled_cmd(0xDA); oled_cmd(0x12); oled_cmd(0xDB);
  oled_cmd(0x40); oled_cmd(0x8D); oled_cmd(0x14); oled_cmd(0xAF);
  OLED_Clear();
  OLED_Update();
}

void OLED_Clear(void)
{
  memset(oled_buffer, 0, sizeof(oled_buffer));
  cursor_x = 0;
  cursor_y = 0;
}

void OLED_Update(void)
{
  for (uint8_t page = 0; page < 8U; ++page)
  {
    oled_cmd((uint8_t)(0xB0U + page));
    oled_cmd(0x00);
    oled_cmd(0x10);
    oled_data(&oled_buffer[OLED_WIDTH * page], OLED_WIDTH);
  }
}

void OLED_SetCursor(uint8_t x, uint8_t y)
{
  cursor_x = x;
  cursor_y = y;
}

void OLED_DrawPixel(uint8_t x, uint8_t y, uint8_t on)
{
  if (x >= OLED_WIDTH || y >= OLED_HEIGHT)
  {
    return;
  }
  if (on)
  {
    oled_buffer[x + (y / 8U) * OLED_WIDTH] |= (uint8_t)(1U << (y & 7U));
  }
  else
  {
    oled_buffer[x + (y / 8U) * OLED_WIDTH] &= (uint8_t)~(1U << (y & 7U));
  }
}

static void oled_char(char c)
{
  uint8_t index;
  if (c == '\n')
  {
    cursor_x = 0;
    cursor_y = (uint8_t)(cursor_y + 8U);
    return;
  }
  if (c < 32 || c > 126)
  {
    c = '?';
  }
  index = (uint8_t)c - 32U;
  for (uint8_t col = 0; col < 5U; ++col)
  {
    uint8_t bits = font5x7[index][col];
    for (uint8_t row = 0; row < 7U; ++row)
    {
      OLED_DrawPixel((uint8_t)(cursor_x + col), (uint8_t)(cursor_y + row), (bits >> row) & 1U);
    }
  }
  cursor_x = (uint8_t)(cursor_x + 6U);
  if (cursor_x > OLED_WIDTH - 6U)
  {
    cursor_x = 0;
    cursor_y = (uint8_t)(cursor_y + 8U);
  }
}

void OLED_Print(const char *text)
{
  while (*text)
  {
    oled_char(*text++);
  }
}

void OLED_PrintAt(uint8_t x, uint8_t y, const char *text)
{
  OLED_SetCursor(x, y);
  OLED_Print(text);
}

void OLED_DrawLine(uint8_t x0, uint8_t y0, uint8_t x1, uint8_t y1)
{
  int16_t dx = (x1 > x0) ? (int16_t)(x1 - x0) : (int16_t)(x0 - x1);
  int16_t sx = (x0 < x1) ? 1 : -1;
  int16_t dy = (y1 > y0) ? (int16_t)(y0 - y1) : (int16_t)(y1 - y0);
  int16_t sy = (y0 < y1) ? 1 : -1;
  int16_t err = (int16_t)(dx + dy);

  while (1)
  {
    int16_t e2;
    OLED_DrawPixel(x0, y0, 1);
    if (x0 == x1 && y0 == y1)
    {
      break;
    }
    e2 = (int16_t)(2 * err);
    if (e2 >= dy)
    {
      err = (int16_t)(err + dy);
      x0 = (uint8_t)((int16_t)x0 + sx);
    }
    if (e2 <= dx)
    {
      err = (int16_t)(err + dx);
      y0 = (uint8_t)((int16_t)y0 + sy);
    }
  }
}

void OLED_DrawRect(uint8_t x, uint8_t y, uint8_t w, uint8_t h)
{
  OLED_DrawLine(x, y, (uint8_t)(x + w - 1U), y);
  OLED_DrawLine(x, (uint8_t)(y + h - 1U), (uint8_t)(x + w - 1U), (uint8_t)(y + h - 1U));
  OLED_DrawLine(x, y, x, (uint8_t)(y + h - 1U));
  OLED_DrawLine((uint8_t)(x + w - 1U), y, (uint8_t)(x + w - 1U), (uint8_t)(y + h - 1U));
}
